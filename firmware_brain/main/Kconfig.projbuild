## firmware_brain/main/Kconfig.projbuild
```kconfig
menu "Robot head controller"
config ROBOT_HEAD_REMOTE
    bool "Control display and gimbal through Luckfox / STM32F103"
    default y
    help
        Enable for the new wiring. Never disable this while the camera is
        connected to the former display/servo GPIOs: legacy drivers would
        drive camera data pins. Remote UART uses GPIO9 TX / GPIO18 RX.
endmenu
```

## firmware_brain/sdkconfig.defaults
```kconfig
# 目标芯片：ESP32-S3
CONFIG_IDF_TARGET="esp32s3"

# 新接线：屏幕和舵机在C8T6；禁止ESP驱动已改接摄像头的数据脚。
CONFIG_ROBOT_HEAD_REMOTE=y

# CPU 频率：240 MHz 满血性能
CONFIG_ESP_DEFAULT_CPU_FREQ_MHZ_240=y
CONFIG_ESP_DEFAULT_CPU_FREQ_MHZ=240

# Flash 配置：16MB Flash, 80MHz 高速模式
CONFIG_ESPTOOLPY_FLASHSIZE_16MB=y
CONFIG_ESPTOOLPY_FLASHSIZE="16MB"
CONFIG_ESPTOOLPY_FLASHMODE_QIO=y
CONFIG_ESPTOOLPY_FLASHFREQ_80M=y

# PSRAM 配置：8MB Octal (OPI)
CONFIG_SPIRAM=y
CONFIG_SPIRAM_MODE_OCT=y
CONFIG_SPIRAM_SPEED_80M=y
CONFIG_SPIRAM_BOOT_INIT=y
CONFIG_SPIRAM_USE_MALLOC=y

# 操作系统时钟频率：1000 Hz (1ms 滴答)
CONFIG_FREERTOS_HZ=1000

# 开启 HTTP 服务器的 WebSocket 全双工长连接支持
CONFIG_HTTPD_WS_SUPPORT=y

# 自定义分区表 (16MB Flash 分区布局)
CONFIG_PARTITION_TABLE_CUSTOM=y
CONFIG_PARTITION_TABLE_CUSTOM_FILENAME="partitions.csv"

# mbedTLS TLS 握手缓存使用外部 PSRAM 分配并开启动态缓冲
CONFIG_MBEDTLS_EXTERNAL_MEM_ALLOC=y
CONFIG_MBEDTLS_DYNAMIC_BUFFER=y
CONFIG_CAMERA_AF_SUPPORT=y

# 控制HTTP与图像HTTP各占监听/控制socket，另留客户端和DNS连接余量。
CONFIG_LWIP_MAX_SOCKETS=16

# 此板实测直接PSRAM DMA无法持续取得JPEG，使用SRAM分段DMA。
CONFIG_CAMERA_PSRAM_DMA=n
```
